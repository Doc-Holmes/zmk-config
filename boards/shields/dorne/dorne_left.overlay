#include "dorne.dtsi"

&physical_layout0 {
    kscan = &kscan0;
};

&kscan0: kscan0 {
      compatible = "zmk,kscan-gpio-matrix";
      //wakeup-source; Might add when the important stuff is working
      diode-direction = "row2col";

      row-gpios
        = <&pro_micro 4 GPIO_ACTIVE_HIGH>
        , <&pro_micro 5 GPIO_ACTIVE_HIGH>
        , <&pro_micro 6 GPIO_ACTIVE_HIGH>
        , <&pro_micro 7 GPIO_ACTIVE_HIGH>
        ;

      col-gpios
        = <&pro_micro 21 (GPIO_PULL_DOWN | GPIO_ACTIVE_HIGH)>
        , <&pro_micro 20 (GPIO_PULL_DOWN | GPIO_ACTIVE_HIGH)>
        , <&pro_micro 19 (GPIO_PULL_DOWN | GPIO_ACTIVE_HIGH)>
        , <&pro_micro 18 (GPIO_PULL_DOWN | GPIO_ACTIVE_HIGH)>
        , <&pro_micro 15 (GPIO_PULL_DOWN | GPIO_ACTIVE_HIGH)>
        , <&pro_micro 14 (GPIO_PULL_DOWN | GPIO_ACTIVE_HIGH)>
        ;
};
