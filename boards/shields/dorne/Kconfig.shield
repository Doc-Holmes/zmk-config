## boards/shields/dorne/Kconfig.shield
```kconfig
# Copyright (c) 2020 Pete Johanson
# SPDX-License-Identifier: MIT

config SHIELD_DORNE_DONGLE
    def_bool $(shields_list_contains,dorne_dongle)

config SHIELD_CORNE_LEFT
    def_bool $(shields_list_contains,dorne_left)

config SHIELD_CORNE_RIGHT
    def_bool $(shields_list_contains,dorne_right)
```
